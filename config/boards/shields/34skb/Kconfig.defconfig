## config/boards/shields/34skb/Kconfig.defconfig
```kconfig
if SHIELD_34SKB_LEFT

config ZMK_KEYBOARD_NAME
    default "34SKB"

config ZMK_SPLIT_ROLE_CENTRAL
    default y

endif

if SHIELD_34SKB_LEFT || SHIELD_34SKB_RIGHT

config ZMK_SPLIT
    default y

endif
```

## config/boards/shields/34skb/Kconfig.shield
```kconfig
config SHIELD_34SKB_LEFT
    def_bool $(shields_list_contains,34skb_left)

config SHIELD_34SKB_RIGHT
    def_bool $(shields_list_contains,34skb_right)
```
